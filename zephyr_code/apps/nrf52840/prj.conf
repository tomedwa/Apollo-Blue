## CMakeLists.txt
```
# SPDX-License-Identifier: Apache-2.0

cmake_minimum_required(VERSION 3.20.0)
find_package(Zephyr REQUIRED HINTS $ENV{ZEPHYR_BASE})
project(nrf52840)

target_sources(app PRIVATE
    src/main.c
    ${CMAKE_CURRENT_SOURCE_DIR}/../../mylib/nrf52840_ibeacon_adv.c
    ${CMAKE_CURRENT_SOURCE_DIR}/../../mylib/nrf52840_uart.c
)
```

## prj.conf
```kconfig
CONFIG_GPIO=y
CONFIG_HEAP_MEM_POOL_SIZE=256

CONFIG_BT=y
CONFIG_BT_DEVICE_NAME="Apollo-Blue-NRF"

CONFIG_SERIAL=y
CONFIG_UART_INTERRUPT_DRIVEN=y
```

## src/main.c
```c
#include <stdio.h>
#include <zephyr/kernel.h>
#include <zephyr/drivers/gpio.h>
#include "../../../include/nrf52840_ibeacon_adv.h"
#include "../../../include/nrf52840_uart.h"


int main(void) {
	
    nrf52840_ibeacon_adv_init();
    nrf52840_uart_init();

    while (1) {
        k_sleep(K_FOREVER);
    }

	return 0;
}
```
